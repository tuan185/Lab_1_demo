# file: lab_1.ioc
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Mcu.Family=STM32F1
Mcu.Name=STM32F103C6Ux
Mcu.Package=UFQFPN48
NVIC.PriorityGroup=NVIC_PRIORITYGROUP_4
PA5.Signal=GPIO_Output
ProjectManager.HeapSize=0x200
ProjectManager.StackSize=0x400
ProjectManager.TargetToolchain=STM32CubeIDE
RCC.APB1Freq_Value=8000000
RCC.APB2Freq_Value=8000000
board=custom

// file: Core/Src/main.c
/* USER CODE BEGIN Header */
/**
  ******************************************************************************
  * @file           : main.c
  * @brief          : Main program body
  ******************************************************************************
  * @attention
  *
  * Copyright (c) 2023 STMicroelectronics.
  * All rights reserved.
  *
  * This software is licensed under terms that can be found in the LICENSE file
  * in the root directory of this software component.
  * If no LICENSE file comes with this software, it is provided AS-IS.
  *
  ******************************************************************************
  */
/* USER CODE END Header */
#include "main.h"

void SystemClock_Config(void);
static void MX_GPIO_Init(void);

int main(void)
{

  /* MCU Configuration--------------------------------------------------------*/

  /* Reset of all peripherals, Initializes the Flash interface and the Systick. */
  HAL_Init();

  /* USER CODE BEGIN Init */
  uint8_t green_counter = 4;
  uint8_t yellow_counter = 2;
  uint8_t status = 0;		// 0-green, 1-yellow, 2-across green, 3-across yellow
  /* USER CODE END Init */

  /* Configure the system clock */
  SystemClock_Config();

  /* Initialize all configured peripherals */
  MX_GPIO_Init();
  /* USER CODE BEGIN 2 */
  HAL_GPIO_WritePin(GPIOB, GPIO_PIN_3, SET);
  HAL_GPIO_WritePin(GPIOB, GPIO_PIN_4, SET);
  /* USER CODE END 2 */

  /* Infinite loop */
  while (1)
  {
	  if(status == 0){
		  green_counter--;
		  if(green_counter <= 0){
			  HAL_GPIO_WritePin(GPIOB, GPIO_PIN_2, SET);
			  HAL_GPIO_WritePin(GPIOB, GPIO_PIN_3, RESET);
			  green_counter = 3;
			  status = 1;
		  }
	  }else if(status == 1){
		  yellow_counter--;
		  if(yellow_counter <= 0){
			  HAL_GPIO_WritePin(GPIOB, GPIO_PIN_1, SET);
			  HAL_GPIO_WritePin(GPIOB, GPIO_PIN_2, RESET);
			  HAL_GPIO_WritePin(GPIOB, GPIO_PIN_4, RESET);
			  HAL_GPIO_WritePin(GPIOB, GPIO_PIN_6, SET);
			  yellow_counter = 2;
			  status = 2;
		  }
	  }else if(status == 2){
		  green_counter--;
		  if(green_counter <= 0){
			  HAL_GPIO_WritePin(GPIOB, GPIO_PIN_5, SET);
			  HAL_GPIO_WritePin(GPIOB, GPIO_PIN_6, RESET);
			  green_counter = 3;
			  status = 3;
		  }
	  }else if(status == 3){
		  yellow_counter--;
		  if(yellow_counter <= 0){
			  HAL_GPIO_WritePin(GPIOB, GPIO_PIN_4, SET);
			  HAL_GPIO_WritePin(GPIOB, GPIO_PIN_5, RESET);
			  HAL_GPIO_WritePin(GPIOB, GPIO_PIN_1, RESET);
			  HAL_GPIO_WritePin(GPIOB, GPIO_PIN_3, SET);
			  yellow_counter = 2;
			  status = 0;
		  }
	  }
	  HAL_Delay(1000);
  }
}

void SystemClock_Config(void)
{
  RCC_OscInitTypeDef RCC_OscInitStruct = {0};
  RCC_ClkInitTypeDef RCC_ClkInitStruct = {0};

  /** Initializes the RCC Oscillators according to the specified parameters
  * in the RCC_OscInitTypeDef structure.
  */
  RCC_OscInitStruct.OscillatorType = RCC_OSCILLATORTYPE_HSI;
  RCC_OscInitStruct.HSIState = RCC_HSI_ON;
  RCC_OscInitStruct.HSICalibrationValue = RCC_HSICALIBRATION_DEFAULT;
  RCC_OscInitStruct.PLL.PLLState = RCC_PLL_NONE;
  if (HAL_RCC_OscConfig(&RCC_OscInitStruct) != HAL_OK)
  {
    Error_Handler();
  }

  /** Initializes the CPU, AHB and APB buses clocks
  */
  RCC_ClkInitStruct.ClockType = RCC_CLOCKTYPE_HCLK|RCC_CLOCKTYPE_SYSCLK
                              |RCC_CLOCKTYPE_PCLK1|RCC_CLOCKTYPE_PCLK2;
  RCC_ClkInitStruct.SYSCLKSource = RCC_SYSCLKSOURCE_HSI;
  RCC_ClkInitStruct.AHBCLKDivider = RCC_SYSCLK_DIV1;
  RCC_ClkInitStruct.APB1CLKDivider = RCC_HCLK_DIV1;
  RCC_ClkInitStruct.APB2CLKDivider = RCC_HCLK_DIV1;

  if (HAL_RCC_ClockConfig(&RCC_ClkInitStruct, FLASH_LATENCY_0) != HAL_OK)
  {
    Error_Handler();
  }
}

static void MX_GPIO_Init(void)
{
  GPIO_InitTypeDef GPIO_InitStruct_0 = {0};		//RED
  GPIO_InitTypeDef GPIO_InitStruct_1 = {0};		//YELLOW
  GPIO_InitTypeDef GPIO_InitStruct_2 = {0};		//GREEN
  GPIO_InitTypeDef GPIO_InitStruct_3 = {0};		//ACROSS-RED
  GPIO_InitTypeDef GPIO_InitStruct_4 = {0};		//ACROSS-YELLOW
  GPIO_InitTypeDef GPIO_InitStruct_5 = {0};		//ACROSS-GREEN

  /* GPIO Ports Clock Enable */
  __HAL_RCC_GPIOB_CLK_ENABLE();

  /*Configure GPIO pin Output Level */
  HAL_GPIO_WritePin(GPIOB, GPIO_PIN_1, GPIO_PIN_RESET);
  HAL_GPIO_WritePin(GPIOB, GPIO_PIN_2, GPIO_PIN_RESET);
  HAL_GPIO_WritePin(GPIOB, GPIO_PIN_3, GPIO_PIN_RESET);
  HAL_GPIO_WritePin(GPIOB, GPIO_PIN_4, GPIO_PIN_RESET);
  HAL_GPIO_WritePin(GPIOB, GPIO_PIN_5, GPIO_PIN_RESET);
  HAL_GPIO_WritePin(GPIOB, GPIO_PIN_6, GPIO_PIN_RESET);

  /*Configure GPIO pin : PC1 */
  GPIO_InitStruct_0.Pin = GPIO_PIN_1;
  GPIO_InitStruct_0.Mode = GPIO_MODE_OUTPUT_PP;
  GPIO_InitStruct_0.Pull = GPIO_NOPULL;
  GPIO_InitStruct_0.Speed = GPIO_SPEED_FREQ_LOW;
  HAL_GPIO_Init(GPIOB, &GPIO_InitStruct_0);
  /*Configure GPIO pin : PC2 */
  GPIO_InitStruct_1.Pin = GPIO_PIN_2;
  GPIO_InitStruct_1.Mode = GPIO_MODE_OUTPUT_PP;
  GPIO_InitStruct_1.Pull = GPIO_NOPULL;
  GPIO_InitStruct_1.Speed = GPIO_SPEED_FREQ_LOW;
  HAL_GPIO_Init(GPIOB, &GPIO_InitStruct_1);
  /*Configure GPIO pin : PC3 */
   GPIO_InitStruct_2.Pin = GPIO_PIN_3;
   GPIO_InitStruct_2.Mode = GPIO_MODE_OUTPUT_PP;
   GPIO_InitStruct_2.Pull = GPIO_NOPULL;
   GPIO_InitStruct_2.Speed = GPIO_SPEED_FREQ_LOW;
   HAL_GPIO_Init(GPIOB, &GPIO_InitStruct_2);
   /*Configure GPIO pin : PC4 */
   GPIO_InitStruct_3.Pin = GPIO_PIN_4;
   GPIO_InitStruct_3.Mode = GPIO_MODE_OUTPUT_PP;
   GPIO_InitStruct_3.Pull = GPIO_NOPULL;
   GPIO_InitStruct_3.Speed = GPIO_SPEED_FREQ_LOW;
   HAL_GPIO_Init(GPIOB, &GPIO_InitStruct_3);
   /*Configure GPIO pin : PC5 */
   GPIO_InitStruct_4.Pin = GPIO_PIN_5;
   GPIO_InitStruct_4.Mode = GPIO_MODE_OUTPUT_PP;
   GPIO_InitStruct_4.Pull = GPIO_NOPULL;
   GPIO_InitStruct_4.Speed = GPIO_SPEED_FREQ_LOW;
   HAL_GPIO_Init(GPIOB, &GPIO_InitStruct_4);
   /*Configure GPIO pin : PC6 */
   GPIO_InitStruct_5.Pin = GPIO_PIN_6;
   GPIO_InitStruct_5.Mode = GPIO_MODE_OUTPUT_PP;
   GPIO_InitStruct_5.Pull = GPIO_NOPULL;
   GPIO_InitStruct_5.Speed = GPIO_SPEED_FREQ_LOW;
   HAL_GPIO_Init(GPIOB, &GPIO_InitStruct_5);

}

void Error_Handler(void)
{
  __disable_irq();
  while (1)
  {
  }
}
